// File: autd3-arduino-sample.ino
// Project: autd3-arduino-sample
// Created Date: 12/10/2022
// Author: Shun Suzuki
// -----
// Last Modified: 12/10/2022
// Modified By: Shun Suzuki (suzuki@hapis.k.u-tokyo.ac.jp)
// -----
// Copyright (c) 2022 Shun Suzuki. All rights reserved.
//

#include <inttypes.h>
#include <stdio.h>
#include <string.h>

#if defined(GRROSE)
#include "FreeRTOS.h"
#include "task.h"
#endif

#include <SOEM.h>

#define NUM_TRANS_IN_X (18)
#define NUM_TRANS_IN_Y (14)
#define NUM_TRANS_IN_UNIT (249)
#define TRANS_SPACING (10.16f)
#define IS_MISSING_TRANSDUCER(x, y) ((y == 1) && ((x == 1) || (x == 2) || (x == 16)))

#define HEADER_SIZE (128)
#define BODY_SIZE (498)
#define INPUT_SIZE (2)
#define EC_CYCLE_TIME_BASE_NANO_SEC (500 * 1000)

#define MSG_CLEAR (0x00)
#define MSG_RD_CPU_VERSION (0x01)
#define MSG_RD_FPGA_VERSION (0x03)
#define MSG_RD_FPGA_FUNCTION (0x04)
#define MSG_BEGIN (0x05)
#define MSG_END (0xF0)

#define FPGA_CTL_LEGACY_MODE (1 << 0)

#define CPU_CTL_MOD (1 << 0)
#define CPU_CTL_MOD_BEGIN (1 << 1)
#define CPU_CTL_MOD_END (1 << 2)
#define CPU_CTL_WRITE_BODY (1 << 3)

#define MSG_ID_IDX (0)
#define FPGA_CTL_IDX (1)
#define CPU_CTL_IDX (2)
#define MOD_SIZE_IDX (3)
#define MOD_FREQ_DIV_IDX (4)
#define MOD_BEGIN_IDX (8)

#define SYNC0_CYCLE (2)
#define SEND0_CYCLE (2)
#define DEV_NUM (1)

int expected_wkc;
unsigned long time;
int64_t toff = 0;
int64_t ts;
int initialized = 0;
char msg_id = MSG_BEGIN;

char IOmap[(HEADER_SIZE + BODY_SIZE + INPUT_SIZE) * DEV_NUM];

char MOD_DATA[80] = {
    0x55, 0x6c, 0x84, 0x9d, 0xb7, 0xd2, 0xed, 0xf6, 0xdb, 0xc0, 0xa6, 0x8c, 0x74, 0x5c, 0x47, 0x33, 0x22, 0x13, 0x9,  0x2,
    0x0,  0x2,  0x9,  0x13, 0x22, 0x33, 0x47, 0x5c, 0x74, 0x8c, 0xa6, 0xc0, 0xdb, 0xf6, 0xed, 0xd2, 0xb7, 0x9d, 0x84, 0x6c,
    0x55, 0x40, 0x2d, 0x1d, 0x10, 0x6,  0x1,  0x0,  0x4,  0xc,  0x18, 0x27, 0x39, 0x4e, 0x64, 0x7c, 0x95, 0xaf, 0xc9, 0xe4,
    0xff, 0xe4, 0xc9, 0xaf, 0x95, 0x7c, 0x64, 0x4e, 0x39, 0x27, 0x18, 0xc,  0x4,  0x0,  0x1,  0x6,  0x10, 0x1d, 0x2d, 0x40,
};

char FOCUS_DATA[498] = {
    0xd6, 0xff, 0x4e, 0xff, 0xd4, 0xff, 0x69, 0xff, 0xf,  0xff, 0xc5, 0xff, 0x8c, 0xff, 0x66, 0xff, 0x53, 0xff, 0x52, 0xff, 0x65, 0xff, 0x8a, 0xff,
    0xc1, 0xff, 0xa,  0xff, 0x64, 0xff, 0xce, 0xff, 0x48, 0xff, 0xcf, 0xff, 0x70, 0xff, 0xfc, 0xff, 0x9f, 0xff, 0x53, 0xff, 0x1a, 0xff, 0xf3, 0xff,
    0xdf, 0xff, 0xde, 0xff, 0xf1, 0xff, 0x17, 0xff, 0x50, 0xff, 0x9a, 0xff, 0xf6, 0xff, 0x63, 0xff, 0x68, 0xff, 0x19, 0xff, 0x8c, 0xff, 0xd,  0xff,
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    0x42, 0xff, 0x55, 0xff, 0x7a, 0xff, 0xb1, 0xff, 0xfb, 0xff, 0x55, 0xff, 0xbf, 0xff, 0x39, 0xff, 0xc1, 0xff,
};

char get_msg_id() {
  if (msg_id >= MSG_END) msg_id = MSG_BEGIN;
  return msg_id++;
}

int64_t ec_sync(const int64_t reftime, const int64_t cycletime, int64_t* integral) {
  int64_t delta = (reftime - 50000) % cycletime;
  if (delta > (cycletime / 2)) delta -= cycletime;
  if (delta > 0) *integral += 1;
  if (delta < 0) *integral -= 1;
  return -(delta / 100) - (*integral / 20);
}

void ecat_run() {
  ts += EC_CYCLE_TIME_BASE_NANO_SEC * SEND0_CYCLE + toff;

  while ((int64_t)micros() * 1000 < ts) {
  }

  if (ec_slave[0].state != EC_STATE_OPERATIONAL) {
    printf("EC_STATE changed: {}", ec_slave[0].state);
    ec_slave[0].state = EC_STATE_OPERATIONAL;
    ec_writestate(0);
  }

  ec_send_processdata();
  if (ec_receive_processdata(EC_TIMEOUTRET) != expected_wkc) return;

  ec_sync(ec_DCtime, EC_CYCLE_TIME_BASE_NANO_SEC * SEND0_CYCLE, &toff);
}

int PO2SO(const uint16_t slave) {
  ec_dcsync0(slave, true, EC_CYCLE_TIME_BASE_NANO_SEC * SYNC0_CYCLE, 0U);
  return 0;
}

int init_autd() {
  const char ifname[] = "";
  if (ec_init(ifname) <= 0) {
    printf("No socket connection\n");
    return -1;
  }

  const int wc = ec_config_init(0);
  if (wc <= 0) {
    printf("No slaves found\n");
    return -1;
  }

  if (wc != DEV_NUM) {
    printf("The number of slaves you configured: %d, but found: %d\n", DEV_NUM, wc);
    return -1;
  }

  for (int cnt = 1; cnt <= ec_slavecount; cnt++) ec_slave[cnt].PO2SOconfig = PO2SO;

  ec_configdc();

  ec_config_map(IOmap);

  ec_statecheck(0, EC_STATE_SAFE_OP, EC_TIMEOUTSTATE * 4);
  ec_readstate();
  ec_slave[0].state = EC_STATE_OPERATIONAL;
  ec_writestate(0);

  expected_wkc = ec_group[0].outputsWKC * 2 + ec_group[0].inputsWKC;
  ts = micros() * 1000;

  return 0;
}

void init_app() {
  Serial.begin(115200);
  memset(IOmap, 0, (HEADER_SIZE + BODY_SIZE + INPUT_SIZE) * DEV_NUM);
}

void focus() {
  for (int dev = 0; dev < DEV_NUM; dev++) {
    IOmap[(HEADER_SIZE + BODY_SIZE) * dev + BODY_SIZE + MSG_ID_IDX] = get_msg_id();
    IOmap[(HEADER_SIZE + BODY_SIZE) * dev + BODY_SIZE + FPGA_CTL_IDX] = FPGA_CTL_LEGACY_MODE;
    IOmap[(HEADER_SIZE + BODY_SIZE) * dev + BODY_SIZE + CPU_CTL_IDX] = CPU_CTL_MOD | CPU_CTL_MOD_BEGIN | CPU_CTL_MOD_END | CPU_CTL_WRITE_BODY;
    IOmap[(HEADER_SIZE + BODY_SIZE) * dev + BODY_SIZE + MOD_SIZE_IDX] = 80;
    IOmap[(HEADER_SIZE + BODY_SIZE) * dev + BODY_SIZE + MOD_FREQ_DIV_IDX] = 0x00;
    IOmap[(HEADER_SIZE + BODY_SIZE) * dev + BODY_SIZE + MOD_FREQ_DIV_IDX + 1] = 0xa0;
    memcpy(IOmap + (HEADER_SIZE + BODY_SIZE) * dev + BODY_SIZE + MOD_BEGIN_IDX, MOD_DATA, 80);
    memcpy(IOmap + (HEADER_SIZE + BODY_SIZE) * dev, FOCUS_DATA, 498);
  }
}

void quit_autd() {
  for (int dev = 0; dev < DEV_NUM; dev++) {
    IOmap[(HEADER_SIZE + BODY_SIZE) * dev + BODY_SIZE + MSG_ID_IDX] = MSG_CLEAR;
  }
}

#if defined(GRROSE)
void app_loop();
void app_main(void* arg) {
  int loop_guard = 0;
  while (1) {
    if (loop_guard) return;
    loop_guard = 1;
    app_loop();
    loop_guard = 0;
  }
}
void setup() {
  init_app();
  int ret = xTaskCreate(app_main, "APP_MAIN_TASK", 10 * 1024, NULL, 3, NULL);
}
void loop() {}
void app_loop()
#else
void setup() { init_app(); }
void loop()
#endif
{
  if (!initialized) {
    printf("Initializing AUTD...");

    if (init_autd() != 0) {
      printf("Failed.\n");
      while (1) {
      }
    }

    printf("DONE.\n");
    initialized = 1;
  }

  if (Serial.available() > 0) {
    char c = Serial.read();
    switch (c) {
      case 'f':
        Serial.println("Producing a focus...");
        focus();
        printf("DONE.\n");
        break;
      case 'q':
        Serial.println("Quiting AUTD...");
        quit_autd();
        printf("DONE.\n");
        break;
    }
  }

  if (initialized) ecat_run();
}
