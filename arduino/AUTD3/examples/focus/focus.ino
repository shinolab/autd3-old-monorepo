// File: focus.ino
// Project: focus
// Created Date: 13/10/2022
// Author: Shun Suzuki
// -----
// Last Modified: 13/10/2022
// Modified By: Shun Suzuki (suzuki@hapis.k.u-tokyo.ac.jp)
// -----
// Copyright (c) 2022 Shun Suzuki. All rights reserved.
//

#include <inttypes.h>
#include <stdio.h>
#include <string.h>

#if defined(GRROSE)
#include "FreeRTOS.h"
#include "task.h"
#endif

#include <AUTD3.h>
#include <SOEM.h>

AUTD3 autd = AUTD3();

char MOD_DATA[80] = {
    0x55, 0x6c, 0x84, 0x9d, 0xb7, 0xd2, 0xed, 0xf6, 0xdb, 0xc0, 0xa6, 0x8c, 0x74, 0x5c, 0x47, 0x33, 0x22, 0x13, 0x9,  0x2,
    0x0,  0x2,  0x9,  0x13, 0x22, 0x33, 0x47, 0x5c, 0x74, 0x8c, 0xa6, 0xc0, 0xdb, 0xf6, 0xed, 0xd2, 0xb7, 0x9d, 0x84, 0x6c,
    0x55, 0x40, 0x2d, 0x1d, 0x10, 0x6,  0x1,  0x0,  0x4,  0xc,  0x18, 0x27, 0x39, 0x4e, 0x64, 0x7c, 0x95, 0xaf, 0xc9, 0xe4,
    0xff, 0xe4, 0xc9, 0xaf, 0x95, 0x7c, 0x64, 0x4e, 0x39, 0x27, 0x18, 0xc,  0x4,  0x0,  0x1,  0x6,  0x10, 0x1d, 0x2d, 0x40,
};

char FOCUS_DATA[498] = {
    0xd6, 0xff, 0x4e, 0xff, 0xd4, 0xff, 0x69, 0xff, 0xf,  0xff, 0xc5, 0xff, 0x8c, 0xff, 0x66, 0xff, 0x53, 0xff, 0x52, 0xff, 0x65, 0xff, 0x8a, 0xff,
    0xc1, 0xff, 0xa,  0xff, 0x64, 0xff, 0xce, 0xff, 0x48, 0xff, 0xcf, 0xff, 0x70, 0xff, 0xfc, 0xff, 0x9f, 0xff, 0x53, 0xff, 0x1a, 0xff, 0xf3, 0xff,
    0xdf, 0xff, 0xde, 0xff, 0xf1, 0xff, 0x17, 0xff, 0x50, 0xff, 0x9a, 0xff, 0xf6, 0xff, 0x63, 0xff, 0x68, 0xff, 0x19, 0xff, 0x8c, 0xff, 0xd,  0xff,
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    0x42, 0xff, 0x55, 0xff, 0x7a, 0xff, 0xb1, 0xff, 0xfb, 0xff, 0x55, 0xff, 0xbf, 0xff, 0x39, 0xff, 0xc1, 0xff,
};

#if defined(GRROSE)
void app_loop();
void app_main(void* arg) {
  if (autd.open() != 0) {
    printf("Failed to open AUTD3.\n");
    while (1)
      ;
  }
  while (1) {
    app_loop();
  }
}
void setup() {
  Serial.begin(115200);
  int ret = xTaskCreate(app_main, "APP_MAIN_TASK", 10 * 1024, NULL, 3, NULL);
}
void loop() { ; }
#else
void setup() {
  Serial.begin(115200);
  if (autd.open() != 0) {
    printf("Failed to open AUTD3.\n");
    while (1)
      ;
  }
}
#endif

#if defined(GRROSE)
void app_loop()
#else
void loop()
#endif
{
  if (Serial.available() > 0) {
    char c = Serial.read();
    switch (c) {
      case 'f':
        Serial.println("Producing a focus...");
        autd.set_gain(FOCUS_DATA);
        autd.set_modulation(MOD_DATA, 80);
        printf("DONE.\n");
        break;
      case 'q':
        Serial.println("Quiting AUTD...");
        autd.stop();
        printf("DONE.\n");
        break;
    }
  }

  autd.run();
}
